/*
 * USART.c
 *
 * Created: 2025-08-13 오후 3:35:47
 * Author : COMPUTER
 * 기능: USART0를 이용한 문자열 송신 및 인터럽트 기반 수신
 */

#include <avr/io.h>         // AVR 레지스터 정의 헤더
#include <avr/interrupt.h>  // 인터럽트 관련 정의
#include <util/delay.h>     // _delay_ms() 함수 사용을 위한 헤더

volatile char rx_buf = 0;   // 수신 데이터를 저장할 전역 변수 (인터럽트에서 접근하므로 volatile 사용)

//--------------------------------------------------------
// USART0 수신 인터럽트 서비스 루틴
// 설명: UART로 데이터가 들어오면 자동 실행됨
//--------------------------------------------------------
ISR(USART0_RX_vect) {
	rx_buf = UDR0;          // 수신 데이터 레지스터에서 문자 읽어와 rx_buf에 저장
}

//--------------------------------------------------------
// 함수명: usart0_init
// 기능: USART0 초기화 (115200bps 기준, 16MHz 클럭)
// 설정: 비동기, 8비트 데이터, 패리티 없음, 1 스탑비트
// 사용: 수신/송신 가능 + 수신 인터럽트 활성화
//--------------------------------------------------------
void usart0_init() {
	UCSR0A = 0x00;          // USART 설정 초기화 (기본값, 변경 없음)
	UCSR0B = 0x98;          // RXEN0(수신), TXEN0(송신), RXCIE0(수신 인터럽트) 활성화 → 10011000
	UCSR0C = 0x06;          // 비동기 모드, No parity, 1 stop bit, 8-bit data → UCSZ01=1, UCSZ00=1
	UBRR0H = 0x00;          // 보레이트 상위 바이트
	UBRR0L = 0x07;          // 보레이트 하위 바이트 → 115200bps @ 16MHz 클럭 기준
	sei();                  // 전역 인터럽트 활성화
}

//--------------------------------------------------------
// 함수명: USART0_char
// 기능: USART0로 문자 1개 송신
//--------------------------------------------------------
void USART0_char(char data) {
	while (!(UCSR0A & 0x20));  // 송신 준비 완료 대기 (UDRE0 비트 확인)
	UDR0 = data;               // 데이터 전송
}

//--------------------------------------------------------
// 함수명: USART0_str
// 기능: 문자열을 USART0로 전송
//--------------------------------------------------------
void USART0_str(char* str) {
	while (*str)               // 문자열 끝(NULL)까지 반복
		USART0_char(*str++);   // 문자 하나씩 송신
}

//--------------------------------------------------------
// main 함수
// 설명:
// - USART0 초기화
// - 매초 "Test" 문자열 송신
// - 수신 데이터가 들어오면 다시 그대로 송신 (에코)
//--------------------------------------------------------
int main(void) {
	usart0_init();             // USART0 초기화

	while (1) {
		USART0_str("Test\n");  // "Test" 문자열 송신

		// 수신 버퍼에 데이터가 있으면 (0이 아니면)
		if (rx_buf) {
			USART0_char(rx_buf);  // 받은 문자 다시 송신 (에코)
			rx_buf = 0;           // 수신 버퍼 초기화 (다시 받을 준비)
		}

		_delay_ms(1000);       // 1초 대기
	}
}
